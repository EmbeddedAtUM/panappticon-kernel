## kernel/eventlogging/Kconfig
```kconfig
#
# Event logging framework for Lide Zhang and David Bild.
#
#

menuconfig EVENT_LOGGING
        bool "Event Logging Zhang/Bild"
        help
          Event tracing framework for Lide Zhang and David Bild.

if EVENT_LOGGING

config EVENT_CPU_ONLINE
       bool "Log when cpu comes online"
       default yes

config EVENT_CPU_DOWN_PREPARE
       bool "Log when cpu prepares to go offline"
       default yes

config EVENT_CPU_DEAD
       bool "Log when cpu goes offline"
       default yes

config EVENT_WAKE_LOCK
       bool "Log when a kernel wakelock is acquired"
       default yes

config EVENT_WAKE_UNLOCK
       bool "Log when a kernel wakelock is released"
       default yes

config EVENT_CONTEXT_SWITCH
       bool "Log context switches"
       default no

config EVENT_IDLE_START
       bool "Log when idle loop starts"
       default yes

config EVENT_IDLE_END
       bool "Log when idle loop stops"
       default yes

config EVENT_FORK
       bool "Log forks"
       default yes

config EVENT_EXIT
       bool "Log when process exits"
       default yes

config EVENT_IO_BLOCK
       bool "Log IO blocks"
       default yes

config EVENT_IO_RESUME
       bool "Log IO resumes"
       default yes

config EVENT_DATAGRAM_BLOCK
       bool "Log datagram blocks"
       default yes

config EVENT_DATAGRAM_RESUME
       bool "Log datagram resumes"
       default yes

config EVENT_STREAM_BLOCK
       bool "Log stream blocks"
       default yes

config EVENT_STREAM_RESUME
       bool "Log stream resumes"
       default yes

config EVENT_SOCK_BLOCK
       bool "Log socket blocks"
       default yes

config EVENT_SOCK_RESUME
       bool "Log socket resumes"
       default yes

config EVENT_SEMAPHORE_LOCK
       bool "Log semaphore locks"
       default no

config EVENT_SEMAPHORE_WAIT
       bool "Log semaphore waits"
       default yes

config EVENT_MUTEX_LOCK
       bool "Log mutex locks"
       default no

config EVENT_MUTEX_WAIT
       bool "Log mutex waits"
       default yes

config EVENT_MUTEX_WAKE
       bool "Log mutex wake"
       default yes

config EVENT_MUTEX_NOTIFY
       bool "Log who wakes up a mutex"
       default yes

config EVENT_THREAD_NAME
       bool "Log when a process name is changed"
       default yes

endif
```
